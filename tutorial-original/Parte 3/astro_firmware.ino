//Entra a https://github.com/robsoncouto/arduino-songs para explicaciones del codigo del buzzer :p

#include <SPI.h>
#include <Wire.h>
#include <Adafruit_GFX.h>
#include <Adafruit_SH1106.h>
#include <Fonts/FreeMonoBoldOblique24pt7b.h>
#include <Servo.h>

#define SCREEN_WIDTH 128
#define SCREEN_HEIGHT 64

#define OLED_RESET     4 
Adafruit_SH1106 display(OLED_RESET);

// --- v2: nombres corregidos ---
// La cara es un bitmap de 128 de ANCHO x 64 de ALTO. En el original estos dos
// #define tenian los nombres cruzados (height=128) y "andaba" solo porque
// tambien se pasaban cruzados a drawBitmap(). Dos errores que se cancelaban.
#define BITMAP_ANCHO   128
#define BITMAP_ALTO    64

Servo servoMotor;    // brazo izquierdo (pin 9)
Servo servoMotor2;   // brazo derecho   (pin 10)

// --- v2: boton para disparar el show ---
// Pulsador entre el pin 2 y GND. INPUT_PULLUP usa la resistencia interna del
// Arduino: el pin queda en HIGH (5V) en reposo y baja a LOW al apretar. Por eso
// no hace falta resistencia externa, y "apretado" se lee como LOW.
const int PIN_BOTON = 2;

#define NOTE_B0  31
#define NOTE_C1  33
#define NOTE_CS1 35
#define NOTE_D1  37
#define NOTE_DS1 39
#define NOTE_E1  41
#define NOTE_F1  44
#define NOTE_FS1 46
#define NOTE_G1  49
#define NOTE_GS1 52
#define NOTE_A1  55
#define NOTE_AS1 58
#define NOTE_B1  62
#define NOTE_C2  65
#define NOTE_CS2 69
#define NOTE_D2  73
#define NOTE_DS2 78
#define NOTE_E2  82
#define NOTE_F2  87
#define NOTE_FS2 93
#define NOTE_G2  98
#define NOTE_GS2 104
#define NOTE_A2  110
#define NOTE_AS2 117
#define NOTE_B2  123
#define NOTE_C3  131
#define NOTE_CS3 139
#define NOTE_D3  147
#define NOTE_DS3 156
#define NOTE_E3  165
#define NOTE_F3  175
#define NOTE_FS3 185
#define NOTE_G3  196
#define NOTE_GS3 208
#define NOTE_A3  220
#define NOTE_AS3 233
#define NOTE_B3  247
#define NOTE_C4  262
#define NOTE_CS4 277
#define NOTE_D4  294
#define NOTE_DS4 311
#define NOTE_E4  330
#define NOTE_F4  349
#define NOTE_FS4 370
#define NOTE_G4  392
#define NOTE_GS4 415
#define NOTE_A4  440
#define NOTE_AS4 466
#define NOTE_B4  494
#define NOTE_C5  523
#define NOTE_CS5 554
#define NOTE_D5  587
#define NOTE_DS5 622
#define NOTE_E5  659
#define NOTE_F5  698
#define NOTE_FS5 740
#define NOTE_G5  784
#define NOTE_GS5 831
#define NOTE_A5  880
#define NOTE_AS5 932
#define NOTE_B5  988
#define NOTE_C6  1047
#define NOTE_CS6 1109
#define NOTE_D6  1175
#define NOTE_DS6 1245
#define NOTE_E6  1319
#define NOTE_F6  1397
#define NOTE_FS6 1480
#define NOTE_G6  1568
#define NOTE_GS6 1661
#define NOTE_A6  1760
#define NOTE_AS6 1865
#define NOTE_B6  1976
#define NOTE_C7  2093
#define NOTE_CS7 2217
#define NOTE_D7  2349
#define NOTE_DS7 2489
#define NOTE_E7  2637
#define NOTE_F7  2794
#define NOTE_FS7 2960
#define NOTE_G7  3136
#define NOTE_GS7 3322
#define NOTE_A7  3520
#define NOTE_AS7 3729
#define NOTE_B7  3951
#define NOTE_C8  4186
#define NOTE_CS8 4435
#define NOTE_D8  4699
#define NOTE_DS8 4978
#define REST      0

#define LEDID_1 5000
#define LEDID_2 5001


const unsigned char epd_bitmap_1 [] PROGMEM = {
	0xff, 0xff, 0xff, 0xff, 0xff, 0xff, 0xff, 0xff, 0xff, 0xff, 0xff, 0xff, 0xff, 0xff, 0xff, 0xff, 
	0xff, 0xff, 0xff, 0xe0, 0x00, 0x00, 0x7f, 0xff, 0xff, 0xfe, 0x00, 0x00, 0x07, 0xff, 0xff, 0xff, 
	0xff, 0xff, 0xff, 0xe0, 0x00, 0x00, 0x7f, 0xff, 0xff, 0xfe, 0x00, 0x00, 0x07, 0xff, 0xff, 0xff, 
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	0xff, 0x80, 0x00, 0xff, 0xff, 0xff, 0x80, 0x00, 0x00, 0x00, 0x1f, 0xff, 0xff, 0x80, 0x01, 0xff
};



// Velocidad de la cancion (mas alto = mas rapido)
int tempo = 120;

// El pin del buzzer
const int buzzer = 3;

// Angulo de reposo de los brazos (90 = centro; evito los extremos 0/180 que
// hacen zumbar y forzar el tope mecanico del SG90).
const int BRAZO_REPOSO = 90;

// --- Melodia: pares (NOTA, duracion) ---
// Duracion: 4=negra, 8=corchea, 16=semicorchea; negativo = con puntillo (x1.5).
// v2: saque el par "14, 99" del original. No era musica: 14 no es ninguna nota
// definida y 99 no es una duracion valida; el parser lo tocaba como ~20ms de
// 14 Hz (inaudible) y de paso movia los servos. Si queres una pausa, es REST.
int melody[] = {
  //TUTU TI TU TU TU TU TURURU
  NOTE_D4, 16, NOTE_D4, 16, NOTE_D5, -16, REST, 32, NOTE_A4, -16, REST, 16,
  NOTE_GS4, 16, REST, 16, NOTE_G4, 16, REST, 16, NOTE_F4, 8, NOTE_D4, 16,
  NOTE_F4, 16, NOTE_G4, 16,
};

// Cantidad total de enteros del arreglo (no de pares); lo recorremos de a 2.
const int melodyLen  = sizeof(melody) / sizeof(melody[0]);
const int wholenote  = (60000 * 4) / tempo;

// ---------------------------------------------------------------------------
//  Estado del "show" (maquina de estados, SIN delay())
// ---------------------------------------------------------------------------
// Idea clave de la v2: en vez de dormir con delay() dentro de setup(), loop()
// corre miles de veces por segundo y en cada pasada pregunta "¿ya toca hacer
// algo?" comparando millis() (ms desde que encendio) contra el momento en que
// vence la nota actual. Es un scheduler cooperativo: el micro nunca se congela,
// asi que puede animar la cara MIENTRAS suena la musica.
bool          showSonando   = false;  // ¿estamos reproduciendo la melodia?
int           notaIndex     = 0;      // posicion dentro de melody[] (avanza de a 2)
unsigned long notaEmpezoEn  = 0;      // millis() en que arranco la nota actual
int           notaDuracionMs = 0;     // cuanto dura la nota actual
bool          poseBrazos    = false;  // alterna la pose de los brazos por nota

// ===========================================================================
//  FUNCIONES AUXILIARES (todas cortas y sin delay)
// ===========================================================================

// Dibuja la cara. offsetY la corre unos pixeles en vertical (para el "respira").
void dibujarCara(int offsetY) {
  display.clearDisplay();
  display.drawBitmap(0, offsetY, epd_bitmap_1, BITMAP_ANCHO, BITMAP_ALTO, WHITE);
  display.display();
}

// Alterna la pose de los brazos en cada nota (bailan al ritmo).
void moverBrazos() {
  poseBrazos = !poseBrazos;
  if (poseBrazos) {
    servoMotor.write(60);    // izquierdo arriba
    servoMotor2.write(120);  // derecho abajo (espejado)
  } else {
    servoMotor.write(120);
    servoMotor2.write(60);
  }
}

// Lee el boton con anti-rebote. Devuelve true SOLO en el instante en que se
// aprieta (flanco de bajada), no mientras lo mantenes apretado.
// Los 'static' hacen que estas variables recuerden su valor entre llamadas.
bool botonRecienApretado() {
  static bool estadoEstable = HIGH;
  static bool ultimaLectura = HIGH;
  static unsigned long tCambio = 0;
  const unsigned long ANTIREBOTE_MS = 30;

  bool lectura = digitalRead(PIN_BOTON);
  if (lectura != ultimaLectura) {          // hubo un cambio: reinicia el reloj
    tCambio = millis();
    ultimaLectura = lectura;
  }
  // Si el nivel se mantuvo estable mas que el anti-rebote, lo aceptamos.
  if (millis() - tCambio > ANTIREBOTE_MS && lectura != estadoEstable) {
    estadoEstable = lectura;
    if (estadoEstable == LOW) return true; // recien apretado
  }
  return false;
}

// Arranca el show desde la primera nota.
void arrancarShow() {
  showSonando    = true;
  notaIndex      = 0;
  notaEmpezoEn   = millis();
  notaDuracionMs = 0;        // 0 => la primera nota suena ya, en la proxima pasada
  dibujarCara(0);            // cara quieta mientras baila (timing de musica prolijo)
}

// Termina el show y deja todo en reposo.
void terminarShow() {
  showSonando = false;
  noTone(buzzer);
  servoMotor.write(BRAZO_REPOSO);
  servoMotor2.write(BRAZO_REPOSO);
}

// Motor del show: avanza una nota SOLO cuando la anterior vencio. Reemplaza al
// for + delay() del original. Cada llamada retorna enseguida.
void actualizarShow() {
  if (!showSonando) return;
  // ¿La nota actual todavia esta sonando? Entonces no hago nada aun.
  if (millis() - notaEmpezoEn < (unsigned long)notaDuracionMs) return;

  noTone(buzzer);                    // corta la nota anterior

  if (notaIndex >= melodyLen) {      // se acabo la melodia
    terminarShow();
    return;
  }

  int nota    = melody[notaIndex];
  int divisor = melody[notaIndex + 1];
  int dur;
  if (divisor > 0) {
    dur = wholenote / divisor;
  } else {                           // nota con puntillo: dura 1.5x
    dur = wholenote / abs(divisor);
    dur = dur + dur / 2;
  }

  tone(buzzer, nota, dur * 0.9);     // suena el 90%; el 10% final queda en silencio
  moverBrazos();                     // baila en cada nota

  notaEmpezoEn   = millis();
  notaDuracionMs = dur;
  notaIndex     += 2;                // siguiente par (nota, duracion)
}

// En reposo la cara "respira": sube y baja 2px cada 400ms. Es la prueba de que
// loop() no esta bloqueado: pasa esto mientras espera el boton.
void actualizarCaraIdle() {
  static unsigned long ultimoFrame = 0;
  static int offset = 0;
  const unsigned long RITMO_MS = 400;
  if (millis() - ultimoFrame < RITMO_MS) return;
  ultimoFrame = millis();
  offset = (offset == 0) ? 2 : 0;
  dibujarCara(offset);
}

// ===========================================================================
//  setup(): corre UNA vez al encender. Solo inicializa; NO reproduce el show.
// ===========================================================================
void setup() {
  pinMode(PIN_BOTON, INPUT_PULLUP);

  display.begin(SH1106_SWITCHCAPVCC, 0x3C);
  dibujarCara(0);                    // muestra la cara apenas enciende

  servoMotor.attach(9);
  servoMotor2.attach(10);
  servoMotor.write(BRAZO_REPOSO);
  servoMotor2.write(BRAZO_REPOSO);
}

// ===========================================================================
//  loop(): corre miles de veces por segundo. Aca vive TODA la accion ahora.
// ===========================================================================
void loop() {
  if (botonRecienApretado() && !showSonando) {
    arrancarShow();                  // apretaste el boton => empieza el show
  }

  if (showSonando) {
    actualizarShow();                // musica + brazos, sin bloquear
  } else {
    actualizarCaraIdle();            // en reposo la cara respira
  }
}
